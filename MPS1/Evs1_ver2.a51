;F(X3,X2,X1,X0) == 1 <=> 1,4,6,8,9,11,14
ORG 0000h;
BASEADDRESS EQU 0011h;11h
RELATIVEADDRESS EQU 0004h;04h
LJMP MAIN
;ORG 5000
MAIN:
;MOV P0, #0FFh
P4 EQU 0C0h
MOV P2, #0000h
MOV 11h, #04h;LOAD TO 11H VALUE 04H
MOV 04h, #00h; LOAD TO 04H HIGH BITS OF EXTERNAL ADDRESS
MOV 05H, #80h;LOAD TO 04H LOW BITS OF EXTERNAL ADDRESS
MOV R0, 04h
MOV P2, 05h

MOV A,  #01010010b
MOVX  @R0, A	;0-7 truth table in ex memory
MOV A, R0
ADD A, #1h
MOV R0, A
MOV A,  #01001011b
MOVX @R0, A;8-15 truth table in ex memory
CLR P4.0;
SETB P4.1;
MET1:
MOV DPTR,#7FFBh	;address isReady flag
isReady:		;check flag isReady
MOVX A,@DPTR	;read flag
ANL A,#01h		;select 0 bit
JZ isReady
MOV DPTR,#7FFAh	;addres of (x3,x2,x1,x0) tuple
MOVX A,@DPTR	;write tuple to A
MOV 20h, A		;write x3,x2,x1,x0 to 20h
; F(x3,x2,x1,x0) = ^x0 & x2 & x1 v ^x3 & ^x0 & x2 v ^x2 & ^x1 & x0 v x3 & ^x2 & (x0 v ^x1)
;X3 - 3, X2 - 2, X1 - 1, X0 - 0

MOV C, ACC.0 ;C = X0
CPL C;C = ^X0
ANL C, ACC.2; C = ^X0 & X2
ANL C, ACC.1; C = ^X0 & X2 & X1
MOV 20h.4, C; 03 = ^X0 & X2 & X1 -- 1

MOV C, ACC.3;C = X3
ORL C, ACC.0; C = X3 V X0
CPL C; C = ^X3 & ^X0
ANL C, ACC.2; C = ^X3 & ^X0 & X2
ORL C, 20h.4; C = ^x0 & x2 & x1 v ^x3 & ^x0 & x2
MOV 20h.4, C; 03 = ^x0 & x2 & x1 v ^x3 & ^x0 & x2 -- 2

MOV C, ACC.2;C = X2
ORL C, ACC.1; C = X2 V X1
CPL C; C = ^X2 & ^X1
ANL C, ACC.0; C = ^X2 & ^X1 & X0
ORL C, 20h.4; C = ^x0 & x2 & x1 v ^x3 & ^x0 & x2 v ^x2 & ^x1 & x0
MOV 20h.4, C; 03 = ^x0 & x2 & x1 v ^x3 & ^x0 & x2 v ^x2 & ^x1 & x0 -- 4

MOV C, ACC.1; C = X1
CPL C; C = ^X1
ORL C, ACC.0; C = X0 V ^X1
CPL C; C = ^X0 & X1
ORL C, ACC.2; C = X2 V (^X0 & X1)
CPL C; C = ^X2 & (X0 V ^X1)
ANL C, ACC.3; C = X3 & ^X2 & (X0 V ^X1)
ORL C, 20h.4; C = ^x0 & x2 & x1 v ^x3 & ^x0 & x2 v ^x2 & ^x1 & x0 v x3 & ^x2 & (x0 v ^x1)
MOV	P4.0,C	;res:=F
; LOADING IDEALS
MOV R0, #BASEADDRESS
JB ACC.3, SECOND	;esli nabor >7
MOV A, @R0; A = RELATIVE ADDRESS
MOV R0, A
MOV A, @R0;LOW BITS OF EXTERNAL ADDRESS
MOV R2, A ; SAVE LOW BITS
MOV A, R0 ; WRITE TO ACC FOR INCREMENTING DATA ADDRESS
ADD A, #1; INCREMENT
MOV R1, A; WRITE DATA ADDRESS TO R1 FOR HIGH BITS 
MOV P2, @R1; HIGH BITS OF EXTERNAL ADDRESS
MOV A, R2
MOV R0, A
MOVX A, @R0; A = IDEALS
MOV B, 20h
ANL B, #00000111b
AJMP NEXT;
SECOND:
MOV A, @R0; A = RELATIVE ADDRESS
MOV R0, A
MOV A, @R0 ;LOW BITS OF EXTERNAL ADDRESS
ADD A, #1
MOV R2, A ; SAVE LOW BITS
MOV A, R0 ; WRITE TO ACC FOR INCREMENTING DATA ADDRESS
ADD A, #1; INCREMENT
MOV R1, A; WRITE DATA ADDRESS TO R1 FOR HIGH BITS 
MOV P2, @R1; HIGH BITS OF EXTERNAL ADDRESS
MOV A, R2
MOV R0, A
MOVX A, @R0; A = IDEALS
MOV B, 20h
ANL B, #00001111b
NEXT:
XCH A, B		; A = COUNTER
JZ END_OF_CYCLE	; if count = 0
XCH A, B		; A = half of truth table, B = count
cycle:
RR A;
DJNZ B, cycle;
END_OF_CYCLE:
MOV B, A;
MOV C, B.0		;bit FROM TABLE
CPL C			; INVERT C
MOV P4.1, C		; P4.1 = INVERTED BIT FROM TABLE
MOV DPTR,#7FFBh
MOV A, 00h
AJMP MET1;
END